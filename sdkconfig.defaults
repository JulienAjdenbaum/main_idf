## sdkconfig.defaults
```kconfig
CONFIG_RC522_CS_GPIO=5
CONFIG_RC522_MISO_GPIO=19
CONFIG_RC522_MOSI_GPIO=23
CONFIG_RC522_SCK_GPIO=18
CONFIG_RC522_RST_GPIO=22
CONFIG_RC522_SPI_CLOCK_SPEED_HZ=1000000  # 1MHz
CONFIG_I2S_SUPPRESS_DEPRECATED_WARN=y
CONFIG_ADC_SUPPRESS_DEPRECATED_WARN=y
CONFIG_I2S_USE_LEGACY_DRIVER=y
CONFIG_I2S_SUPPRESS_DEPRECATE_WARN=y
CONFIG_ADC_SUPPRESS_DEPRECATE_WARN=y
```
